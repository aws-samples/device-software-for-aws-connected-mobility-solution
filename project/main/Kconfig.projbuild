## project/main/Kconfig.projbuild
```kconfig
menu "Example Configuration"

config MQTT_CLIENT_IDENTIFIER
    string "The MQTT client identifier used in this example"
	default "testClient"
	help
        The MQTT client identifier used in this example. Each client identifier must be unique.
        so edit as required to ensure that no two clients connecting to the same broker use the same client identifier.

config MQTT_BROKER_ENDPOINT
    string "Endpoint of the MQTT broker to connect to"
    default "test.mosquitto.org"
    help
        This example can be run with any MQTT broker, that supports server authentication.

config MQTT_BROKER_PORT
    int "Port of the MQTT broker use"
    default 8884
    help
        In general, port 8883 is for secured MQTT connections.
        Port 443 requires use of the ALPN TLS extension with the ALPN protocol name.
        When using port 8883, ALPN is not required.

config MQTT_OPTION_SNI
    int "An option to disable Server Name Indication"
    range 0 1
    default 0
    help
        When using a local Mosquitto server setup, SNI needs to be disabled
        for an MQTT broker that only has an IP address but no hostname. However,
        SNI should be enabled whenever possible.

config HARDWARE_PLATFORM_NAME
    string "The hardware platform"
    default "ESP32"
    help
        The name of the hardware platform the application is running on.

config MQTT_EXAMPLE_STACKSIZE
    int "Set the stack size of the example task"
    range 5120 8192
    default 5120
    help
        The actual stack is created by an operating system thread.

config MQTT_NETWORK_BUFFER_SIZE
    int "Size of the network buffer for MQTT packets"
    range 1024 2048
    default 1024
    help
        Size of the network buffer for MQTT packets.

config RTSP_STREAMING_URL
    string "RTSP server URL"
    default "rtsp://192.168.8.210:5554/playlist.m3u"
    help
        The mobile phone plays a RTSP server role, and it would provide a URL to indicate the RTSP resource.

config KVS_STREAM_NAME
    string "KVS Stream Name"
    default "testStream"
    help
        The KVS stream name is an identity which can be used for uploading video or play video from.

endmenu

menu "Connected mobility demo config"
    
    config APP_DOWNLOAD_AGENT
        bool "Enable download agent in the demo application"
        default y
        help
            If not enabled. Only default APP will run.
    
    config APP_WASM
        bool "Enable WASM in the demo application"
        default y
        help
            If not enabled, APP_WASM won't start any application.
    
    config APP_KVS
        bool "Enable KVS in the demo application"
        default y
        help
            If not enabled, APP_KVS won't start any application.

    config APP_PUSH_TO_TALK
        bool "Enable PUSH_TO_TALK in the demo application"
        default y
        help
            If not enabled, APP_PUSH_TO_TALK won't start any application.

    config FREEMATICS_ONEPLUS_B
        bool "Build FREEMATICS_ONEPLUS_B in the demo application"
        default y
        help
            If not enabled, build devkitC or Wrover pin configuration.

    config FILE_SYSTEM_ENABLE
        bool "Enable FILE_SYSTEM_ENABLE in the demo application"
        default y
        help
            If not enabled, use RAM instead of file system

    config FS_MOUNT_POINT
        string "file system default mount point"
        default "/sdcard"
        depends on FILE_SYSTEM_ENABLE
        help
            The default file system mount point

    config EXAMPLE_FORMAT_IF_MOUNT_FAILED
        bool "Enable EXAMPLE_FORMAT_IF_MOUNT_FAILED in the demo application"
        default y
        depends on FILE_SYSTEM_ENABLE
        help
            If not enabled, format the SD card when mount failed
    
    choice DEFAULT_APP
        prompt "Default APP"
        default DEFAULT_APP_WASM

        config DEFAULT_APP_WASM
            bool "Default APP WASM"
            depends on APP_WASM
            help
                "Default APP_WASM"

        config DEFAULT_APP_KVS
            bool "Default APP_KVS"
            depends on APP_KVS
            help
                "Default APP_KVS"
        
        config DEFAULT_APP_PUSH_TO_TALK
            bool "Default APP_PUSH_TO_TALK"
            depends on APP_PUSH_TO_TALK
            help
                "Default APP_PUSH_TO_TALK"

        config DEFAULT_APP_NONE
            bool "Default APP_NONE"
            help
                "Default APP_NONE"
    endchoice

config CMS_VIN
    string "cms VIN"
    default "iotlabtpetest"
    help
        This is the VIN for demo car

endmenu
```

## project/sdkconfig.defaults
```kconfig
# newlib for ESP32 and ESP8266 platform

CONFIG_NEWLIB_ENABLE=y
CONFIG_NEWLIB_LIBRARY_LEVEL_NORMAL=y
CONFIG_NEWLIB_NANO_FORMAT=
CONFIG_SSL_USING_MBEDTLS=y
# CONFIG_LWIP_IPV6 is not set

#
# Flash size
#
CONFIG_ESPTOOLPY_FLASHSIZE_4MB=y
CONFIG_ESPTOOLPY_FLASHSIZE="4MB"

#
# ESP32-specific
#
CONFIG_ESP32_DEFAULT_CPU_FREQ_240=y
CONFIG_ESP32_SPIRAM_SUPPORT=y

#
# Common ESP-related
#
CONFIG_ESP_MAIN_TASK_STACK_SIZE=8192

#
# SPI RAM config
#
CONFIG_SPIRAM_TYPE_AUTO=y
CONFIG_SPIRAM_SIZE=-1
CONFIG_SPIRAM_SPEED_40M=y
CONFIG_SPIRAM=y
CONFIG_SPIRAM_BOOT_INIT=y
CONFIG_SPIRAM_USE_MALLOC=y
CONFIG_SPIRAM_MEMTEST=y
CONFIG_SPIRAM_MALLOC_ALWAYSINTERNAL=16384
CONFIG_SPIRAM_MALLOC_RESERVE_INTERNAL=32768
CONFIG_SPIRAM_CACHE_WORKAROUND=y
CONFIG_SPIRAM_ALLOW_BSS_SEG_EXTERNAL_MEMORY=y

CONFIG_FREERTOS_SUPPORT_STATIC_ALLOCATION=y
CONFIG_PARTITION_TABLE_CUSTOM=y
CONFIG_PARTITION_TABLE_CUSTOM_FILENAME="partitions.csv"

# FAT setting
CONFIG_FATFS_LFN_STACK=y
CONFIG_FATFS_MAX_LFN=255
CONFIG_FATFS_API_ENCODING_ANSI_OEM=y

CONFIG_EXAMPLE_WIFI_SSID="Guest"
CONFIG_EXAMPLE_WIFI_PASSWORD="BrokenWires@@2019"

# Compile config
CONFIG_COMPILER_OPTIMIZATION_SIZE=y
CONFIG_COMPILER_OPTIMIZATION_LEVEL_RELEASE=y

# WiFi config
CONFIG_ESP32_WIFI_STATIC_RX_BUFFER_NUM=16
CONFIG_ESP32_WIFI_DYNAMIC_RX_BUFFER_NUM=48
CONFIG_ESP32_WIFI_TX_BA_WIN=32
CONFIG_ESP32_WIFI_RX_BA_WIN=32

# TCP/IP config
CONFIG_LWIP_TCP_SND_BUF_DEFAULT=65535
CONFIG_LWIP_TCP_WND_DEFAULT=65535
CONFIG_LWIP_TCPIP_RECVMBOX_SIZE=64
CONFIG_LWIP_UDP_RECVMBOX_SIZE=32
CONFIG_LWIP_MAX_RAW_PCBS=64
CONFIG_TCPIP_RECVMBOX_SIZE=64
CONFIG_TCP_SND_BUF_DEFAULT=65535
CONFIG_TCP_WND_DEFAULT=65535
CONFIG_TCP_RECVMBOX_SIZE=64
CONFIG_UDP_RECVMBOX_SIZE=32

# mbedTLS config
CONFIG_MBEDTLS_EXTERNAL_MEM_ALLOC=y
CONFIG_MBEDTLS_SSL_IN_CONTENT_LEN=16384
CONFIG_MBEDTLS_SSL_OUT_CONTENT_LEN=16384

#
# ESP-MQTT Configurations
#
# CONFIG_MQTT_PROTOCOL_311 is not set
# CONFIG_MQTT_TRANSPORT_SSL is not set
# CONFIG_MQTT_TRANSPORT_WEBSOCKET is not set

# default client credential
CONFIG_MQTT_CLIENT_IDENTIFIER="ECU-IOTLABTPE-2021-XADSFWEVB"
CONFIG_MQTT_BROKER_ENDPOINT="a2jl9ndedgotsf-ats.iot.us-west-2.amazonaws.com"
CONFIG_MQTT_BROKER_PORT=8883
CONFIG_CMS_VIN="1IOTLABTPE2021001"
```
